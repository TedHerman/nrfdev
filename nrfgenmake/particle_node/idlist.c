#include <string.h>
#include "boards.h"

#include "nrf_log.h"
#include "nrf_log_ctrl.h"
#include "nrf_log_default_backends.h"

typedef struct { uint8_t addr[6]; } master_addr_t;

master_addr_t master_addr_list[] = 
  { { {0xfe,0xe0,0x17,0x9c,0xd9,0xe3} },   // mote 01
    { {0x46,0x8d,0xb6,0x76,0x66,0xfe} },
    { {0x28,0xc1,0x6c,0xde,0xa6,0xf4} },
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    { {0x00,0x00,0x00,0x00,0x00,0x00} },   // mote 35
      };

master_addr_t node_addr_list[] = 
  { { {0xb5,0xf5,0xc6,0x81,0x3f,0xca} },   // mote 10000  
      };

int16_t get_node_id() {
  int16_t i;
  uint8_t * p = (uint8_t*) NRF_FICR->DEVICEADDR;
  for (i=0; i<sizeof(master_addr_list); i++) {
    if (memcmp(master_addr_list[i].addr,p,6) == 0) break;
    }
  if (i < sizeof(master_addr_list)) return i+1; 
  for (i=0; i<sizeof(node_addr_list); i++) {
    if (memcmp(node_addr_list[i].addr,p,6) == 0) break;
    }
  if (i >= sizeof(node_addr_list)) {
    NRF_LOG_INFO("mac address, not in table, is");
    NRF_LOG_HEXDUMP_INFO(p,6);
    NRF_LOG_FLUSH();
    APP_ERROR_CHECK(i);
    }
  return i+10000+1;
  }
